// Make sure settings.dtsi is included before this file

/ {

    behaviors {

        /*
         * Shifted Backspace deletes
         *
         * Usage: &mm_bspc_del
         * Tap: Backspace
         * Shift-Tap: Delete
         */
        mm_bspc_del: bspc_del {
            compatible = "zmk,behavior-mod-morph";
            #binding-cells = <0>;
            bindings = <&kp BSPC>, <&kp DEL>;
            mods = <(MOD_LSFT|MOD_RSFT)>;
        };

    };
};
